## apps/display_image/sdkconfig.defaults
```kconfig
# The board carries 16 MB of flash (esptool flash_id: 0x20 0x4018). The ESP-IDF
# default is 2 MB, which leaves the image header understating the real size and
# the bootloader logging a mismatch warning on every boot. See docs/board.md.
CONFIG_ESPTOOLPY_FLASHSIZE_16MB=y
```

## apps/play_audio/sdkconfig.defaults
```kconfig
# The board carries 16 MB of flash (esptool flash_id: 0x20 0x4018). See docs/board.md.
CONFIG_ESPTOOLPY_FLASHSIZE_16MB=y

# Custom partition table: single app + a large SPIFFS partition for the audio blob.
CONFIG_PARTITION_TABLE_CUSTOM=y
CONFIG_PARTITION_TABLE_CUSTOM_FILENAME="partitions.csv"
```

## apps/rest_api/sdkconfig.defaults
```kconfig
# The board carries 16 MB of flash (esptool flash_id: 0x20 0x4018). See docs/board.md.
CONFIG_ESPTOOLPY_FLASHSIZE_16MB=y

# Custom partition table: app + NVS + SPIFFS scratch partition.
CONFIG_PARTITION_TABLE_CUSTOM=y
CONFIG_PARTITION_TABLE_CUSTOM_FILENAME="partitions.csv"

# HTTP server: allow larger request bodies (image/audio uploads) and a couple of
# extra URI handlers.
CONFIG_HTTPD_MAX_REQ_HDR_LEN=1024
CONFIG_HTTPD_MAX_URI_LEN=512
```
